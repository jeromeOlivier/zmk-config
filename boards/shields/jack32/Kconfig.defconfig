## boards/shields/jack32/Kconfig.defconfig
```kconfig
if SHIELD_JACK32

config ZMK_KEYBOARD_NAME
    default "jack32"

endif # SHIELD_JACK32
```

## config/west.yml
```yaml
manifest:
  remotes:
    - name: zmkfirmware
      url-base: https://github.com/zmkfirmware
    - name: petejohanson
      url-base: https://github.com/petejohanson/zmk/tree/zephyr/3.3-update
  projects:
    - name: zmk
      remote: petejohanson
      revision: zephyr/3.3-update
      import: app/west.yml
  self:
    path: config
```
